## app/Kconfig
```kconfig
menu "Led subsystem"


choice
    prompt "Led blink speed"
    default BLINK_SLEEP_1000MS

config BLINK_SLEEP_250MS
    bool "Fast"

config BLINK_SLEEP_1000MS
    bool "Normal"

config BLINK_SLEEP_2000MS
    bool "Slow"

endchoice

config BLINK_SLEEP_TIME_MS
    int
    default 250 if  BLINK_SLEEP_250MS
    default 1000 if  BLINK_SLEEP_1000MS
    default 2000 if  BLINK_SLEEP_2000MS
    default 0

    menu "Advanced LED settings"

    config LED_BRIGHTNESS
        int "LED brightness (0-100)"
        default 100
        range 0 100

    config LED_FADE_DURATION
        int "LED fade duration (ms)"
        default 500
        
    menu "Expert settings"

        config LED_DEBUG
            bool "Enable LED debugging"
            default n

        config LED_CUSTOM_BLINK
            bool "Custom blink pattern"
            default n

    endmenu

    endmenu
endmenu
source "Kconfig.zephyr"

#config BLINK_SLEEP_TIME_MS
  # int "led Prompt"
   # default 1000
    #range 100 1000
    #help
    #  string can be multiline 
```

## app/boards/my_board/Kconfig.my_board
```kconfig
# Copyright (c) 2025 Seeed Technology Co., Ltd.
# SPDX-License-Identifier: Apache-2.0
config BOARD_MY_BOARD
	select SOC_NRF54L15_CPUAPP if BOARD_MY_BOARD_NRF54L15_CPUAPP
	select SOC_NRF54L15_CPUFLPR if \
		BOARD_MY_BOARD_NRF54L15_CPUFLPR || \
		BOARD_MY_BOARD_NRF54L15_CPUFLPR_XIP
```

## app/boards/my_board/board.yml
```yaml
board:
  name: my_board
  full_name: My Board
  vendor: seeed
  socs:
  - name: nrf54l15
    variants:
    - name: xip
      cpucluster: cpuflpr
```

## app/boards/new_board/Kconfig.new_board
```kconfig
# Copyright (c) 2025
# SPDX-License-Identifier: Apache-2.0

config BOARD_NEW_BOARD
	select SOC_NRF54L15_CPUAPP if BOARD_NEW_BOARD_NRF54L15_CPUAPP
	select SOC_NRF54L15_CPUFLPR if \
		BOARD_NEW_BOARD_NRF54L15_CPUFLPR || \
		BOARD_NEW_BOARD_NRF54L15_CPUFLPR_XIP
```

## app/boards/new_board/board.yml
```yaml
board:
  name: new_board
  full_name: My Board from scratch
  vendor: Test
  socs:
  - name: nrf54l15
    variants:
    - name: cpuapp
      cpucluster: cpuapp
    - name: xip
      cpucluster: cpuflpr
```
